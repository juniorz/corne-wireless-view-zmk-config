#include "cirque_pinnacle.dtsi"
#include <input/processors.dtsi>
#include <dt-bindings/zmk/input_transform.h>

/* central device */
&glidepoint_listener {
    status = "okay";    // enable
};

/* See: https://zmk.dev/docs/development/hardware-integration/pointing?part-type=peripheral#peripheral-configuration-1 */

/*
/ {
    glidepoint_listener {
        compatible = "zmk,input-listener";
        // device = <&glidepoint>;
        // input-processors = <&zip_xy_transform (INPUT_TRANSFORM_XY_SWAP | INPUT_TRANSFORM_X_INVERT | INPUT_TRANSFORM_Y_INVERT)>;

        input-processors = <&zip_xy_transform (INPUT_TRANSFORM_XY_SWAP | INPUT_TRANSFORM_X_INVERT | INPUT_TRANSFORM_Y_INVERT)>;
    };
};
*/