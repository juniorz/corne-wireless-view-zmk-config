## config/boards/shields/central_dongle_input/Kconfig.shield
```kconfig
# Copyright (c) 2020 The ZMK Contributors
# SPDX-License-Identifier: MIT

config SHIELD_CENTRAL_DONGLE_INPUT
    def_bool $(shields_list_contains,central_dongle_input)
```

## config/west.yml
```yaml
manifest:
  remotes:
    - name: zmkfirmware
      url-base: https://github.com/zmkfirmware

    - name: englmaxi
      url-base: https://github.com/englmaxi

    # - name: juniorz
    #   url-base: https://github.com/juniorz

    # - name: petejohanson
    #   url-base: https://github.com/petejohanson

    # - name: gpeye
    #   url-base: https://github.com/GPeye

  projects:
    - name: zmk
      remote: zmkfirmware
      revision: main
      clone-depth: 1
      import: app/west.yml

    # dongle-display
    - name: zmk-dongle-display
      remote: englmaxi
      revision: main # zephir 4.1

    # cirque pinnacle
    - name: zmk-keyboard-cirque-pinnacle
      remote: juniorz
      revision: main
      import: west.yml

    # # - name: zmk-analog-input-driver
    # #   remote: badjeff
    # #   revision: main
    # # - name: zmk-split-peripheral-input-relay
    # #   remote: badjeff
    # #   revision: main
    # # - name: zmk-split-peripheral-output-relay
    # #   remote: badjeff
    # #   revision: main

    # - name: cirque-input-module
    #   remote: juniorz
    #   revision: extra

    # # - name: mario-peripheral-animation
    # #   remote: gpeye
    # #   revision: main
    # # - name: hammerbeam-slideshow
    # #   remote: gpeye
    # #   revision: main

  self:
    path: config
```
