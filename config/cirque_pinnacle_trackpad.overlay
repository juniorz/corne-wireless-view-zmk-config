&gpio1 {
    status = "okay";
};

&i2c0 {
    glidepoint: glidepoint@2a {
        compatible = "cirque,pinnacle";
        status = "okay";

        // P1.01 on my board
        //data-ready-gpios = <&gpio1 1 (GPIO_ACTIVE_HIGH)>;
        //data-ready-gpios = <&pro_micro 1 (GPIO_ACTIVE_HIGH)>;

        // swap-xy;
        sensitivity = "1x";
        invert-x;

        // trackpad is only working when powered by USB.
        // could it be the sleep configuration?
        /delete-property/ sleep-mode-enable;

        // https://github.com/qmk/qmk_firmware/blob/36c3f4deba7e4c670736cc95db144b25156e90f1/drivers/sensors/cirque_pinnacle.c#L177
        //x-axis-z-min = <4>;
        //y-axis-z-min = <3>;

        //scroll;
    };
};
