#include <dt-bindings/zmk/input_transform.h>

/* cirque trackpad I2C pins */
/* See: https://zmk.dev/docs/development/hardware-integration/pointing?part-type=peripheral#input-device */

/*
&glidepoint0 {
        dr-gpios = <&gpio1 1 (GPIO_ACTIVE_HIGH)>;         // P1.01 (maybe it is P1.02)

        sensitivity = "4x";
        sleep;

        // see: https://github.com/petejohanson/cirque-input-module/blob/main/dts/bindings/input/cirque%2Cpinnacle-common.yaml
        //rotate-90 = false;
        //x-invert = false;
        //y-invert = false;
        //sleep = false;
        //no-secondary-tap = false;
        //no-taps = false;
        //sensitivity = 1x | 2x | 3x | 4x
        //x-axis-z-min = 5;
        //y-axis-z-min= 4;
};

&i2c0_default {
    group1 {
      bias-pull-up;
    };
};

*/